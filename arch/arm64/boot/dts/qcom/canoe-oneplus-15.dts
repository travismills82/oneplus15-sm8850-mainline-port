// SPDX-License-Identifier: BSD-3-Clause
/*
 * Copyright (c) 2026, Travis Mills <travismills82@gmail.com>
 */

/dts-v1/;

#include "canoe.dtsi"

/ {
	model = "OnePlus 15";
	compatible = "oneplus,oneplus-15", "qcom,canoe";
};
