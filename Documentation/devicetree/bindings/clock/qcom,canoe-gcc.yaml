## Documentation/devicetree/bindings/clock/qcom,canoe-gcc.yaml
```yaml
# SPDX-License-Identifier: (GPL-2.0-only OR BSD-2-Clause)
%YAML 1.2
---
$id: http://devicetree.org/schemas/clock/qcom,canoe-gcc.yaml#
$schema: http://devicetree.org/meta-schemas/core.yaml#

title: Qualcomm Canoe Global Clock and Reset Controller

maintainers:
  - Bjorn Andersson <andersson@kernel.org>

description: |
  Qualcomm global clock control module providing clocks, resets and power
  domains on the Canoe platform.

  See also:
    include/dt-bindings/clock/qcom,gcc-canoe.h

properties:
  compatible:
    const: qcom,canoe-gcc

  clocks:
    items:
      - description: Board XO source
      - description: PCIe 0 pipe clock source
      - description: Sleep clock source
      - description: UFS PHY RX symbol 0 clock source
      - description: UFS PHY RX symbol 1 clock source
      - description: UFS PHY TX symbol 0 clock source
      - description: USB3 PHY wrapper pipe clock source

  clock-names:
    items:
      - const: bi_tcxo
      - const: pcie_0_pipe_clk
      - const: sleep_clk
      - const: ufs_phy_rx_symbol_0_clk
      - const: ufs_phy_rx_symbol_1_clk
      - const: ufs_phy_tx_symbol_0_clk
      - const: usb3_phy_wrapper_gcc_usb30_pipe_clk

required:
  - compatible
  - clocks
  - clock-names
  - '#power-domain-cells'

allOf:
  - $ref: qcom,gcc.yaml#

unevaluatedProperties: false

examples:
  - |
    clock-controller@100000 {
        compatible = "qcom,canoe-gcc";
        reg = <0x00100000 0x001f4200>;
        clocks = <&bi_tcxo>,
                 <&pcie0_pipe_clk>,
                 <&sleep_clk>,
                 <&ufs_rx0_clk>,
                 <&ufs_rx1_clk>,
                 <&ufs_tx0_clk>,
                 <&usb3_pipe_clk>;
        clock-names = "bi_tcxo",
                      "pcie_0_pipe_clk",
                      "sleep_clk",
                      "ufs_phy_rx_symbol_0_clk",
                      "ufs_phy_rx_symbol_1_clk",
                      "ufs_phy_tx_symbol_0_clk",
                      "usb3_phy_wrapper_gcc_usb30_pipe_clk";
        #clock-cells = <1>;
        #reset-cells = <1>;
        #power-domain-cells = <1>;
    };
...
```

## Documentation/devicetree/bindings/clock/qcom,canoe-tcsr.yaml
```yaml
# SPDX-License-Identifier: GPL-2.0-only OR BSD-2-Clause
%YAML 1.2
---
$id: http://devicetree.org/schemas/clock/qcom,canoe-tcsr.yaml#
$schema: http://devicetree.org/meta-schemas/core.yaml#

title: Qualcomm Canoe TCSR Clock Controller

maintainers:
  - Travis Mills <travismills82@gmail.com>

properties:
  compatible:
    const: qcom,canoe-tcsr

  reg:
    maxItems: 1

  '#clock-cells':
    const: 1

required:
  - compatible
  - reg
  - '#clock-cells'

additionalProperties: false
```

## Documentation/devicetree/bindings/clock/qcom,canoe-tcsrcc.yaml
```yaml
# SPDX-License-Identifier: (GPL-2.0-only OR BSD-2-Clause)
%YAML 1.2
---
$id: http://devicetree.org/schemas/clock/qcom,canoe-tcsrcc.yaml#
$schema: http://devicetree.org/meta-schemas/core.yaml#

title: Qualcomm Canoe TCSR Clock Controller

maintainers:
  - Bjorn Andersson <andersson@kernel.org>

description: |
  The Top Control and Status Register clock controller on Canoe provides
  reference clock gates for PCIe, UFS, USB2 and USB3 consumers.

  See also:
    include/dt-bindings/clock/qcom,canoe-tcsr.h

properties:
  compatible:
    items:
      - const: qcom,canoe-tcsrcc
      - const: syscon

  reg:
    maxItems: 1

  '#clock-cells':
    const: 1

required:
  - compatible
  - reg
  - '#clock-cells'

additionalProperties: false

examples:
  - |
    clock-controller@1fd5044 {
      compatible = "qcom,canoe-tcsrcc", "syscon";
      reg = <0x01fd5044 0x1c>;
      #clock-cells = <1>;
    };
...
```

## Documentation/devicetree/bindings/interconnect/qcom,canoe-rpmh.yaml
```yaml
# SPDX-License-Identifier: (GPL-2.0 OR BSD-2-Clause)
%YAML 1.2
---
$id: http://devicetree.org/schemas/interconnect/qcom,canoe-rpmh.yaml#
$schema: http://devicetree.org/meta-schemas/core.yaml#

title: Qualcomm Canoe RPMh Network-On-Chip Interconnect

maintainers:
  - Travis Mills <travismills82@gmail.com>

description: |
  RPMh interconnect providers on Canoe expose the HLOS-voted Network-On-Chip
  fabrics. Camera, display and PCIe CRM hardware-voter domains are not
  described by this binding.

  The Canoe aggregate NoC combines the downstream aggre1 and aggre2 logical
  provider labels into one physical register block.

  See also:
    include/dt-bindings/interconnect/qcom,canoe-rpmh.h

properties:
  compatible:
    enum:
      - qcom,canoe-aggre-noc
      - qcom,canoe-clk-virt
      - qcom,canoe-cnoc-cfg
      - qcom,canoe-cnoc-main
      - qcom,canoe-gem-noc
      - qcom,canoe-lpass-ag-noc
      - qcom,canoe-lpass-lpiaon-noc
      - qcom,canoe-lpass-lpicx-noc
      - qcom,canoe-mc-virt
      - qcom,canoe-mmss-noc
      - qcom,canoe-nsp-noc
      - qcom,canoe-pcie-anoc
      - qcom,canoe-system-noc

  reg:
    maxItems: 1

  clocks:
    minItems: 2
    maxItems: 3

required:
  - compatible

allOf:
  - $ref: qcom,rpmh-common.yaml#

  - if:
      properties:
        compatible:
          enum:
            - qcom,canoe-clk-virt
            - qcom,canoe-mc-virt
    then:
      properties:
        reg: false
    else:
      required:
        - reg

  - if:
      properties:
        compatible:
          const: qcom,canoe-aggre-noc
    then:
      properties:
        clocks:
          items:
            - description: aggregate UFS PHY AXI clock
            - description: aggregate USB3 primary AXI clock
            - description: RPMh IPA clock
      required:
        - clocks

  - if:
      properties:
        compatible:
          const: qcom,canoe-pcie-anoc
    then:
      properties:
        clocks:
          items:
            - description: aggregate NoC PCIe AXI clock
            - description: config NoC PCIe aNoC AHB clock
      required:
        - clocks

  - if:
      not:
        properties:
          compatible:
            enum:
              - qcom,canoe-aggre-noc
              - qcom,canoe-pcie-anoc
    then:
      properties:
        clocks: false

unevaluatedProperties: false
```
